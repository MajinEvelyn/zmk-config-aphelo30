## boards/shields/aphelo30/Kconfig.defconfig
```kconfig
if SHIELD_APHELO30_LEFT

# Name must be less than 16 characters long!
config ZMK_KEYBOARD_NAME
    default "aphelo30"

config ZMK_SPLIT_ROLE_CENTRAL
    default y

endif

if SHIELD_APHELO30_LEFT || SHIELD_APHELO30_RIGHT

config ZMK_SPLIT
    default y

endif
```

## boards/shields/aphelo30/Kconfig.shield
```kconfig
config SHIELD_APHELO30_LEFT
    def_bool $(shields_list_contains,aphelo30_left)
  
config SHIELD_APHELO30_RIGHT
    def_bool $(shields_list_contains,aphelo30_right)
  
```
